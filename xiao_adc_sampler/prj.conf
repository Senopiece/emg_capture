## CMakeLists.txt
```
# SPDX-License-Identifier: Apache-2.0

cmake_minimum_required(VERSION 3.20.0)

find_package(Zephyr REQUIRED HINTS $ENV{ZEPHYR_BASE})
project(xiao_adc_sampler)

target_sources(app PRIVATE src/main.c)
```

## sample.yaml
```
sample:
  description: Xiao nRF52 ADC Sampling
  name: xiao_adc_sampler
```

## prj.conf
```kconfig
# Drivers and peripherals
CONFIG_I2C=n
CONFIG_WATCHDOG=n
CONFIG_GPIO=n
CONFIG_SPI=n
CONFIG_FLASH=n

# Power management
CONFIG_PM=n

# Memory protection
CONFIG_THREAD_CUSTOM_DATA=n
CONFIG_FPU=n

# Boot
CONFIG_BOOT_BANNER=n
CONFIG_BOOT_DELAY=0

# Console
CONFIG_CONSOLE=n
CONFIG_UART_CONSOLE=n
CONFIG_STDOUT_CONSOLE=n
CONFIG_PRINTK=n
CONFIG_EARLY_CONSOLE=n

# Data acquisition
CONFIG_ADC=y

# Data transfer
# NOTE: logging interferes with packets, so need to disable
CONFIG_USB_DEVICE_STACK=y
CONFIG_USB_CDC_ACM=y
CONFIG_USB_CDC_ACM_RINGBUF_SIZE=4096
CONFIG_LOG=n
```

## src/main.c
```c
#include <zephyr/kernel.h>

#include "packet_sink.h"
#include "sample_channels.h"

#define SAMPLING_FREQUENCY 2048
#define SAMPLE_PERIOD                                                          \
  Z_TIMEOUT_TICKS(sys_clock_hw_cycles_per_sec() / SAMPLING_FREQUENCY)

static struct k_timer sample_timer;
static struct k_work sample_work;

static void sample_work_handler(struct k_work *work) {
  sample_channels();
  send_packet(sampled_channels_buff, CHANNELS);
}

static void sample_timer_handler(struct k_timer *timer) {
  k_work_submit(&sample_work);
}

int main() {
  init_packet_sink();
  init_sample_channels();

  k_work_init(&sample_work, sample_work_handler);
  k_timer_init(&sample_timer, sample_timer_handler, NULL);
  k_timer_start(&sample_timer, SAMPLE_PERIOD, SAMPLE_PERIOD);

  while (1) {
    k_sleep(K_FOREVER);
  }

  return 0;
}
```

## src/packet_sink.h
```c
#pragma once

#include <zephyr/device.h>
#include <zephyr/devicetree.h>
#include <zephyr/drivers/uart.h>
#include <zephyr/kernel.h>
#include <zephyr/usb/usb_device.h>

typedef uint16_t PacketElem;

const struct device *cdc_dev;
const PacketElem _packet_delimiter = 0xFFFF;

void init_packet_sink() { cdc_dev = DEVICE_DT_GET(DT_CHOSEN(zephyr_console)); }

// this code is not blocking, but may cause data loss
// NOTE: logging may interfere
void send_packet(PacketElem values[], uint8_t len) {
  // assert no 0xFFFF in values
  uart_fifo_fill(cdc_dev, (uint8_t *)values, len * sizeof(PacketElem));
  uart_fifo_fill(cdc_dev, (uint8_t *)&_packet_delimiter,
                 sizeof(_packet_delimiter));
}
```

## src/sample_channels.h
```c
#pragma once

#include <zephyr/device.h>
#include <zephyr/drivers/adc.h>
#include <zephyr/kernel.h>

#ifdef CONFIG_ADC_CONFIGURABLE_INPUTS
#include <hal/nrf_saadc.h>
#endif

#define CHANNELS 6
#define ADC_RESOLUTION 12

static const struct device *adc_dev = DEVICE_DT_GET(DT_NODELABEL(adc));

static struct adc_channel_cfg adc_channels[CHANNELS];
static struct adc_sequence adc_seq;
static uint16_t sampled_channels_buff[CHANNELS];

void init_sample_channels(void) {
  for (int i = 0; i < CHANNELS; i++) {
    adc_channels[i].channel_id = i;
    adc_channels[i].differential = 0;

    /* Use maximum acquisition time to reduce noise */
    adc_channels[i].acquisition_time = ADC_ACQ_TIME_DEFAULT;
    adc_channels[i].reference = ADC_REF_INTERNAL; // 0.6 V internal reference

    /* Use gain of 1/6 to allow 3.6V input (3.6V * 1/6 ≈ 0.6V) */
    adc_channels[i].gain = ADC_GAIN_1_6;

#ifdef CONFIG_ADC_CONFIGURABLE_INPUTS
    /* Map each channel to an ADC input pin. For nRF, assume channels 0-5 map
    to
     * AIN0-AIN5 */
    adc_channels[i].input_positive = NRF_SAADC_INPUT_AIN0 + i;
#endif

    adc_channel_setup(adc_dev, &adc_channels[i]);
  }

  adc_seq.options = NULL;
  adc_seq.channels = BIT_MASK(CHANNELS);
  adc_seq.buffer = sampled_channels_buff;
  adc_seq.buffer_size = sizeof(sampled_channels_buff);
  adc_seq.resolution = ADC_RESOLUTION;
  adc_seq.oversampling = 0; // not allowed with scan mode
  adc_seq.calibrate = false;
}

void sample_channels(void) { adc_read(adc_dev, &adc_seq); }
```
